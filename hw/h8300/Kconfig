## hw/h8300/Kconfig
```kconfig
config H8300
    bool

config H83069
    bool
    select H8300
    select RENESAS_TMR
    select RENESAS_TMR16
    select RENESAS_SCI
    select H8300H_INTC

config H8S2674
    bool
    select H8300
    select RENESAS_TMR
    select RENESAS_TPU
    select RENESAS_SCI
    select H8S_INTC

config H8300_KANEBEBE
    bool
    select H83069
    select NE2000_LOCAL

config H8300_EDOSK2674
    bool
    select H8S2674
    select PFLASH_CFI01
    select SMC91C111

config H8300_E2300
    bool
    select H8300
    select BITBANG_I2C
    select DIP_SWITCH
    select BATTERY_SENSOR
    select DS1338
    select GPIO_BEEPER
    select HDSP211X
    select LED
    select MIFARE_MCM
    select SC28C94
    select RFM433
    select RENESAS_SCI
    select TURNSTILE
```
